/*@!Encoding:936*/
includes
{
  
}

variables
{
  char gTestCaseName[100];
  int flag,ErrorDiagCANflagresult=0;
  int RouteNum,i,CANflag=0,ACANflag=0,ECANflag=0,FCANflag=0,ICANflag=0;
  message * gSendMessage,gDestMessage;
  message 0x3c0 m1;
  message 0x7af Low_priorityMsg1;
  message 0x7cf Low_priorityMsg2;
  message 0x7df Low_priorityMsg3;
  
  message 0x004 High_priorityMsg1;
  message 0x002 High_priorityMsg2;
  message 0x003 High_priorityMsg3;
  message 0x7ef Low_priorityMsg;
  message 0x001 High_priorityMsg;
  message 0x700 gSendMessage1;
  message 0x77A gDestMessage1;
  message * BodyloadMsg;
  long flagMsgRouterIDConformance_Direct = 0,gMsgRouterIDConformanceResult_Direct = 0;
  char gStringName[100];
  char gStringValue[100];
  char gStringResult[100];
  char gStringStandard[100];
  msTimer MsgSendTimer,KL15Timer,Busload80,Busload1,Busload2,Busload3,Busload4,Busload5,Busload6;
  long cycle;
   double busloadcycle;
  int ACANflagresult=0,ECANflagresult=0,FCANflagresult=0,ICANflagresult=0,DiagCANflagresult=0;
}
on timer Busload80
{
    output(BodyloadMsg);
    setTimer(Busload80,busloadcycle);
}
on timer Busload1
{
output(Low_priorityMsg1);
 setTimer(Busload1,1); 
}
on timer Busload2
{
output(Low_priorityMsg2);
 setTimer(Busload2,1); 
}
on timer Busload3
{
output(Low_priorityMsg3);
 setTimer(Busload3,1); 
}
on timer Busload4
{
output(High_priorityMsg1);
 setTimer(Busload4,1); 
}
on timer Busload5
{
output(High_priorityMsg2);
 setTimer(Busload5,1); 
}
on timer Busload6
{
output(High_priorityMsg3);
 setTimer(Busload6,1); 
}
on message *
{
  if(this.dir == rx&&this.can==6&&CANflag==1&&this.id==gDestMessage1.id)
  {
    DiagCANflagresult=1;
  }
  else if(this.dir == rx&&CANflag==1&&this.id==gSendMessage1.id)
  {
    ErrorDiagCANflagresult=1;
  }
  if(this.dir == rx&&this.can==2&&CANflag==1&&this.id==gDestMessage.id)
  {
   ACANflagresult=1;
  }
  if(this.dir == rx&&this.can==3&&CANflag==1&&this.id==gDestMessage.id)
  {
   ECANflagresult=1;
  }
  if(this.dir == rx&&this.can==4&&CANflag==1&&this.id==gDestMessage.id)
  {
   FCANflagresult=1;
  }
  if(this.dir == rx&&this.can==5&&CANflag==1&&this.id==gDestMessage.id)
  {
   ICANflagresult=1;
  }
}


on timer MsgSendTimer
{
  output(gSendMessage);
  setTimer(MsgSendTimer,cycle);
}
on timer KL15Timer
{
  output(m1);
  setTimer(KL15Timer,100);
}
void MainTest ()
{
  m1.CAN=1;
  m1.dlc=4;
  m1.byte(0)=0x00;
  m1.byte(1)=0x00;
  m1.byte(2)=0x03;
  m1.byte(3)=0x00;
  setTimer(KL15Timer,10);
  TestCaseSelecting();
  testWaitForTimeout(100);
  cancelTimer(KL15Timer);
}
void TestCaseSelecting()
{ 
//  @sysvar::Env_LogFileState::Env_LogFileState=1;
//  Access_control_detection_6211_1();
//  @sysvar::Env_LogFileState::Env_LogFileState=0;
//  testWaitForTimeout(100);
//   @sysvar::Env_LogFileState::Env_LogFileState=1;
//  Access_control_detection_6211_2();
//   @sysvar::Env_LogFileState::Env_LogFileState=0;
//  testWaitForTimeout(100);
//  @sysvar::Env_LogFileState::Env_LogFileState=1;
//  CAN_DOS_attacktest_6212_1();
//  @sysvar::Env_LogFileState::Env_LogFileState=0;
//  testWaitForTimeout(100);
//  @sysvar::Env_LogFileState::Env_LogFileState=1;
//  CAN_DOS_attacktest_6212_2();
//  @sysvar::Env_LogFileState::Env_LogFileState=0;
//  testWaitForTimeout(100);
//  @sysvar::Env_LogFileState::Env_LogFileState=1;
//  CAN_DOS_attacktest_6212_3();
//  @sysvar::Env_LogFileState::Env_LogFileState=0;
//  testWaitForTimeout(100);
//  @sysvar::Env_LogFileState::Env_LogFileState=1;
//  Dataframe_health_detection_6213();
//  @sysvar::Env_LogFileState::Env_LogFileState=0;
//  testWaitForTimeout(100);
//  @sysvar::Env_LogFileState::Env_LogFileState=1;
//  Dataframe_anomaly_detection_6214();
//  @sysvar::Env_LogFileState::Env_LogFileState=0;
//  testWaitForTimeout(100);
  @sysvar::Env_LogFileState::Env_LogFileState=1;
  UDS_session_detection_6215();
  testWaitForTimeout(100);   
  @sysvar::Env_LogFileState::Env_LogFileState=0;
}
testcase Access_control_detection_6211_2()
{
  int k=1;
 ReportName("Source Network","Destination Network"); 
 testwaitfortimeout(500);
 snprintf(gTestCaseName,elCount(gTestCaseName),"Access_control_detection_6211_2");
  
   for(RouteNum=1;RouteNum<5;RouteNum++)
  {
    if(RouteNum==1)
    {gSendMessage.id=0x4B5;
     gDestMessage.id=0x4B5;
     cycle=100;
    }
    if(RouteNum==2)
    {gSendMessage.id=0x48C;
     gDestMessage.id=0x48C;
     cycle=1000;
    }
    if(RouteNum==3)
    {gSendMessage.id=0x46E;
     gDestMessage.id=0x46E;
     cycle=2000;
    }
    if(RouteNum==4)
    {gSendMessage.id=0x471;
     gDestMessage.id=0x471;
     cycle=2000;
    }
    gSendMessage.can=1;
    gSendMessage.dlc=8;
    for(i=0;i<8;i++)
    {
      gSendMessage.byte(0)=k++;
    } 
    CANflag = 1;
    setTimer(MsgSendTimer,5); 
    testWaitForTimeout(5000);
    cancelTimer(MsgSendTimer);
    CANflag = 0;
      if(ACANflagresult==1)
     {  
       snprintf(gStringName,elcount(gStringName),"Source Network =kCan");                                      
       snprintf(gStringValue,elcount(gStringValue),"Target Network=ACAN");                           
       snprintf(gStringResult,elcount(gStringResult),"Failed");                                         
       snprintf(gStringStandard,elcount(gStringStandard),"CAN ID=0x%x is routing!",gSendMessage.id);              
       ReportValue(gStringName,gStringValue,gStringResult,gStringStandard);
      ACANflagresult=0;
      flag=1;
     }
    else if(ECANflagresult==1)
    {
       snprintf(gStringName,elcount(gStringName),"Source Network =kCan");                                      
       snprintf(gStringValue,elcount(gStringValue),"Target Network=ECAN");                           
       snprintf(gStringResult,elcount(gStringResult),"Failed");                                         
       snprintf(gStringStandard,elcount(gStringStandard),"CAN ID=0x%x is routing!",gSendMessage.id);              
       ReportValue(gStringName,gStringValue,gStringResult,gStringStandard);
      ECANflagresult=0;
      flag=1;
    }
     else if(FCANflagresult==1)
    {
     snprintf(gStringName,elcount(gStringName),"Source Network =kCan");                                      
       snprintf(gStringValue,elcount(gStringValue),"Target Network=FCAN");                           
       snprintf(gStringResult,elcount(gStringResult),"Failed");                                         
       snprintf(gStringStandard,elcount(gStringStandard),"CAN ID=0x%x is routing!",gSendMessage.id);              
       ReportValue(gStringName,gStringValue,gStringResult,gStringStandard); 
      FCANflagresult=0;
      flag=1;
    }
     else if(ICANflagresult==1)
    {
      snprintf(gStringName,elcount(gStringName),"Source Network =kCan");                                      
       snprintf(gStringValue,elcount(gStringValue),"Target Network=ICAN");                           
       snprintf(gStringResult,elcount(gStringResult),"Failed");                                         
       snprintf(gStringStandard,elcount(gStringStandard),"CAN ID=0x%x is routing!",gSendMessage.id);              
       ReportValue(gStringName,gStringValue,gStringResult,gStringStandard);
      ICANflagresult=0;
      flag=1;
    }
  }

    if(flag==0)
     {
       snprintf(gStringName,elcount(gStringName),"Source Network =kCan");                                                                                         
       snprintf(gStringValue,elcount(gStringValue),"Source Network =kCan");                           
       snprintf(gStringResult,elcount(gStringResult),"Passed");                                         
       snprintf(gStringStandard,elcount(gStringStandard),"CAN message Do not route!");             
       ReportValue(gStringName,gStringValue,gStringResult,gStringStandard);
     }
}
testcase CAN_DOS_attacktest_6212_1()
{
 int k;
 ReportName("Source Network","Destination Network"); 
 testwaitfortimeout(500);
 snprintf(gTestCaseName,elCount(gTestCaseName),"Access_control_detection_6212_1"); 
  Low_priorityMsg.can=1;
  Low_priorityMsg.dlc=8;
  Low_priorityMsg.byte(0)=0x11;
  Low_priorityMsg.byte(1)=0x22;
  Low_priorityMsg.byte(2)=0x33;
  Low_priorityMsg.byte(3)=0x44;
  Low_priorityMsg.byte(4)=0x55;
  Low_priorityMsg.byte(6)=0x66;
  Low_priorityMsg.byte(7)=0x77;
  
  Low_priorityMsg1.can=1;
  Low_priorityMsg1.dlc=8;
  Low_priorityMsg1.byte(0)=0x11;
  Low_priorityMsg1.byte(1)=0x22;
  Low_priorityMsg1.byte(2)=0x33;
  Low_priorityMsg1.byte(3)=0x44;
  Low_priorityMsg1.byte(4)=0x55;
  Low_priorityMsg1.byte(6)=0x66;
  Low_priorityMsg1.byte(7)=0x77;
  
    Low_priorityMsg2.can=1;
  Low_priorityMsg2.dlc=8;
  Low_priorityMsg2.byte(0)=0x11;
  Low_priorityMsg2.byte(1)=0x22;
  Low_priorityMsg2.byte(2)=0x33;
  Low_priorityMsg2.byte(3)=0x44;
  Low_priorityMsg2.byte(4)=0x55;
  Low_priorityMsg2.byte(6)=0x66;
  Low_priorityMsg2.byte(7)=0x77;
 
  
  Low_priorityMsg3.can=1;
  Low_priorityMsg3.dlc=8;
  Low_priorityMsg3.byte(0)=0x11;
  Low_priorityMsg3.byte(1)=0x22;
  Low_priorityMsg3.byte(2)=0x33;
  Low_priorityMsg3.byte(3)=0x44;
  Low_priorityMsg3.byte(4)=0x55;
  Low_priorityMsg3.byte(6)=0x66;
  Low_priorityMsg3.byte(7)=0x77;
   BodyloadMsg=Low_priorityMsg;
  setTimer(Busload1,5);
  setTimer(Busload2,5);
  setTimer(Busload3,5);
  busloadcycle=100;
  for(busloadcycle=10;busloadcycle>0;busloadcycle-=1)
  {
  setTimer(Busload80,100);
  testWaitForTimeout(2000);
   if(CAN1.BusLoad>=80)
  { 
    break;
  }
  if(CAN1.BusLoad<80)
  {
    cancelTimer(Busload80);
  }
  }
     for(RouteNum=1;RouteNum<5;RouteNum++)
  {
    if(RouteNum==1)
    {gSendMessage.id=0x3B5;
     gDestMessage.id=0x3B5;
     cycle=100;
    }
    if(RouteNum==2)
    {gSendMessage.id=0x58C;
     gDestMessage.id=0x58C;
     cycle=1000;
    }
    if(RouteNum==3)
    {gSendMessage.id=0x66E;
     gDestMessage.id=0x66E;
     cycle=2000;
    }
    if(RouteNum==4)
    {gSendMessage.id=0x671;
     gDestMessage.id=0x671;
     cycle=2000;
    }
    gSendMessage.can=1;
    gSendMessage.dlc=8;
    for(i=0;i<8;i++)
    {
      gSendMessage.byte(0)=k++;
    } 
    CANflag = 1;
    setTimer(MsgSendTimer,5); 
    testWaitForTimeout(10000);
    cancelTimer(MsgSendTimer);
    CANflag = 0;
    
    if(RouteNum==1&&ACANflagresult==1&&ECANflagresult==1)
     {  
       snprintf(gStringName,elcount(gStringName),"KCan ID=0x%x",gSendMessage.id);                                      
       snprintf(gStringValue,elcount(gStringValue),"ACan ID=0x%x,ECan ID=0x%x",gDestMessage.id,gDestMessage.id);                           
       snprintf(gStringResult,elcount(gStringResult),"Passed");                                         
       snprintf(gStringStandard,elcount(gStringStandard),"LowBusload%80 ID Keep Conformance");              
       ReportValue(gStringName,gStringValue,gStringResult,gStringStandard);
     }
    else if((RouteNum==1&&ACANflagresult==0)||(RouteNum==1&&ECANflagresult==0))
     {
       snprintf(gStringName,elcount(gStringName),"KCan ID=0x%x",gSendMessage.id);                                                                                         
       snprintf(gStringValue,elcount(gStringValue),"ACan ID=0x%x,ECan ID=0x%x",gDestMessage.id,gDestMessage.id);                           
       snprintf(gStringResult,elcount(gStringResult),"Failed");                                         
       snprintf(gStringStandard,elcount(gStringStandard),"LowBusload%80 ID Keep Conformance");             
       ReportValue(gStringName,gStringValue,gStringResult,gStringStandard);
     }
        if(RouteNum==2&&ACANflagresult==1)
     {  
       snprintf(gStringName,elcount(gStringName),"KCan ID=0x%x",gSendMessage.id);                                      
       snprintf(gStringValue,elcount(gStringValue),"ACan ID=0x%x",gDestMessage.id);                           
       snprintf(gStringResult,elcount(gStringResult),"Passed");                                         
       snprintf(gStringStandard,elcount(gStringStandard),"LowBusload%80 ID Keep Conformance");              
       ReportValue(gStringName,gStringValue,gStringResult,gStringStandard);
     }
    else if(RouteNum==2&&ACANflagresult==0)
     {
       snprintf(gStringName,elcount(gStringName),"KCan ID=0x%x",gSendMessage.id);                                                                                         
       snprintf(gStringValue,elcount(gStringValue),"ACan ID=0x%x",gDestMessage.id);                           
       snprintf(gStringResult,elcount(gStringResult),"Failed");                                         
       snprintf(gStringStandard,elcount(gStringStandard),"LowBusload%80 ID Keep Conformance");             
       ReportValue(gStringName,gStringValue,gStringResult,gStringStandard);
     }
        if(RouteNum==3&&ICANflagresult==1&&ECANflagresult==1)
     {  
       snprintf(gStringName,elcount(gStringName),"KCan ID=0x%x",gSendMessage.id);                                      
       snprintf(gStringValue,elcount(gStringValue),"ICan ID=0x%x,ECan ID=0x%x",gDestMessage.id,gDestMessage.id);                           
       snprintf(gStringResult,elcount(gStringResult),"Passed");                                         
       snprintf(gStringStandard,elcount(gStringStandard),"LowBusload%80 ID Keep Conformance");              
       ReportValue(gStringName,gStringValue,gStringResult,gStringStandard);
     }
    else if((RouteNum==3&&ECANflagresult==0)||(RouteNum==1&&ICANflagresult==0))
     {
       snprintf(gStringName,elcount(gStringName),"KCan ID=0x%x",gSendMessage.id);                                                                                         
       snprintf(gStringValue,elcount(gStringValue),"ICan ID=0x%x,ECan ID=0x%x",gDestMessage.id,gDestMessage.id);                           
       snprintf(gStringResult,elcount(gStringResult),"Failed");                                         
       snprintf(gStringStandard,elcount(gStringStandard),"LowBusload%80 ID Keep Conformance");             
       ReportValue(gStringName,gStringValue,gStringResult,gStringStandard);
     }
        if(RouteNum==4&&ICANflagresult==1)
     {  
       snprintf(gStringName,elcount(gStringName),"KCan ID=0x%x",gSendMessage.id);                                      
       snprintf(gStringValue,elcount(gStringValue),"ICan ID=0x%x",gDestMessage.id,gDestMessage.id);                           
       snprintf(gStringResult,elcount(gStringResult),"Passed");                                         
       snprintf(gStringStandard,elcount(gStringStandard),"LowBusload%80 ID Keep Conformance");              
       ReportValue(gStringName,gStringValue,gStringResult,gStringStandard);
     }
    else if(RouteNum==1&&ICANflagresult==0)
     {
       snprintf(gStringName,elcount(gStringName),"KCan ID=0x%x",gSendMessage.id);                                                                                         
       snprintf(gStringValue,elcount(gStringValue),"ICan ID=0x%xx",gDestMessage.id);                           
       snprintf(gStringResult,elcount(gStringResult),"Failed");                                         
       snprintf(gStringStandard,elcount(gStringStandard),"LowBusload%80 ID Keep Conformance");             
       ReportValue(gStringName,gStringValue,gStringResult,gStringStandard);
     }
  }
  cancelTimer(Busload80);
   cancelTimer(Busload1);
  cancelTimer(Busload2);
  cancelTimer(Busload3);
  ACANflagresult=0;ECANflagresult=0;FCANflagresult=0;ICANflagresult=0;
}
testcase CAN_DOS_attacktest_6212_2()
{
  int k;
 ReportName("Source Network","Destination Network"); 
 testwaitfortimeout(500);
 snprintf(gTestCaseName,elCount(gTestCaseName),"Access_control_detection_6212_2"); 
  High_priorityMsg.can=1;
  High_priorityMsg.dlc=8;
  High_priorityMsg.byte(0)=0x11;
  High_priorityMsg.byte(1)=0x22;
  High_priorityMsg.byte(2)=0x33;
  High_priorityMsg.byte(3)=0x44;
  High_priorityMsg.byte(4)=0x55;
  High_priorityMsg.byte(6)=0x66;
  High_priorityMsg.byte(7)=0x77;
  
    High_priorityMsg1.can=1;
  High_priorityMsg1.dlc=8;
  High_priorityMsg1.byte(0)=0x11;
  High_priorityMsg1.byte(1)=0x22;
  High_priorityMsg1.byte(2)=0x33;
  High_priorityMsg1.byte(3)=0x44;
  High_priorityMsg1.byte(4)=0x55;
  High_priorityMsg1.byte(6)=0x66;
  High_priorityMsg1.byte(7)=0x77;
  
    High_priorityMsg2.can=1;
  High_priorityMsg2.dlc=8;
  High_priorityMsg2.byte(0)=0x11;
  High_priorityMsg2.byte(1)=0x22;
  High_priorityMsg2.byte(2)=0x33;
  High_priorityMsg2.byte(3)=0x44;
  High_priorityMsg2.byte(4)=0x55;
  High_priorityMsg2.byte(6)=0x66;
  High_priorityMsg2.byte(7)=0x77;
    High_priorityMsg3.can=1;
  High_priorityMsg3.dlc=8;
  High_priorityMsg3.byte(0)=0x11;
  High_priorityMsg3.byte(1)=0x22;
  High_priorityMsg3.byte(2)=0x33;
  High_priorityMsg3.byte(3)=0x44;
  High_priorityMsg3.byte(4)=0x55;
  High_priorityMsg3.byte(6)=0x66;
  High_priorityMsg3.byte(7)=0x77;
  
  setTimer(Busload4,1);
  setTimer(Busload5,1);
  setTimer(Busload6,1);
  
  BodyloadMsg=High_priorityMsg;
  for(busloadcycle=10;busloadcycle>0;busloadcycle-=1)
  {
  setTimer(Busload80,100);
  testWaitForTimeout(2000);
   if(CAN1.BusLoad>=80)
  { 
    break;
  }
  if(CAN1.BusLoad<80)
  {
    cancelTimer(Busload80);
  }
  }
     for(RouteNum=1;RouteNum<5;RouteNum++)
  {
    if(RouteNum==1)
    {gSendMessage.id=0x3B5;
     gDestMessage.id=0x3B5;
     cycle=100;
    }
    if(RouteNum==2)
    {gSendMessage.id=0x58C;
     gDestMessage.id=0x58C;
     cycle=1000;
    }
    if(RouteNum==3)
    {gSendMessage.id=0x66E;
     gDestMessage.id=0x66E;
     cycle=2000;
    }
    if(RouteNum==4)
    {gSendMessage.id=0x671;
     gDestMessage.id=0x671;
     cycle=2000;
    }
    gSendMessage.can=1;
    gSendMessage.dlc=8;
    for(i=0;i<8;i++)
    {
      gSendMessage.byte(0)=k++;
    } 
    CANflag = 1;
    setTimer(MsgSendTimer,5); 
    testWaitForTimeout(10000);
    cancelTimer(MsgSendTimer);
    CANflag = 0;
   
    if(RouteNum==1&&ACANflagresult==1&&ECANflagresult==1)
     {  
       snprintf(gStringName,elcount(gStringName),"KCan ID=0x%x",gSendMessage.id);                                      
       snprintf(gStringValue,elcount(gStringValue),"ACan ID=0x%x,ECan ID=0x%x",gDestMessage.id,gDestMessage.id);                           
       snprintf(gStringResult,elcount(gStringResult),"Passed");                                         
       snprintf(gStringStandard,elcount(gStringStandard),"HighBusload%80 ID Keep Conformance");              
       ReportValue(gStringName,gStringValue,gStringResult,gStringStandard);
     }
    else if((RouteNum==1&&ACANflagresult==0)||(RouteNum==1&&ECANflagresult==0))
     {
       snprintf(gStringName,elcount(gStringName),"KCan ID=0x%x",gSendMessage.id);                                                                                         
       snprintf(gStringValue,elcount(gStringValue),"ACan ID=0x%x,ECan ID=0x%x",gDestMessage.id,gDestMessage.id);                           
       snprintf(gStringResult,elcount(gStringResult),"Failed");                                         
       snprintf(gStringStandard,elcount(gStringStandard),"HighBusload%80 ID Keep Conformance");             
       ReportValue(gStringName,gStringValue,gStringResult,gStringStandard);
     }
        if(RouteNum==2&&ACANflagresult==1)
     {  
       snprintf(gStringName,elcount(gStringName),"KCan ID=0x%x",gSendMessage.id);                                      
       snprintf(gStringValue,elcount(gStringValue),"ACan ID=0x%x",gDestMessage.id);                           
       snprintf(gStringResult,elcount(gStringResult),"Passed");                                         
       snprintf(gStringStandard,elcount(gStringStandard),"HighBusload%80 ID Keep Conformance");              
       ReportValue(gStringName,gStringValue,gStringResult,gStringStandard);
     }
    else if(RouteNum==2&&ACANflagresult==0)
     {
       snprintf(gStringName,elcount(gStringName),"KCan ID=0x%x",gSendMessage.id);                                                                                         
       snprintf(gStringValue,elcount(gStringValue),"ACan ID=0x%x",gDestMessage.id);                           
       snprintf(gStringResult,elcount(gStringResult),"Failed");                                         
       snprintf(gStringStandard,elcount(gStringStandard),"HighBusload%80 ID Keep Conformance");             
       ReportValue(gStringName,gStringValue,gStringResult,gStringStandard);
     }
        if(RouteNum==3&&ICANflagresult==1&&ECANflagresult==1)
     {  
       snprintf(gStringName,elcount(gStringName),"KCan ID=0x%x",gSendMessage.id);                                      
       snprintf(gStringValue,elcount(gStringValue),"ICan ID=0x%x,ECan ID=0x%x",gDestMessage.id,gDestMessage.id);                           
       snprintf(gStringResult,elcount(gStringResult),"Passed");                                         
       snprintf(gStringStandard,elcount(gStringStandard),"HighBusload%80 ID Keep Conformance");              
       ReportValue(gStringName,gStringValue,gStringResult,gStringStandard);
     }
    else if((RouteNum==3&&ECANflagresult==0)||(RouteNum==1&&ICANflagresult==0))
     {
       snprintf(gStringName,elcount(gStringName),"KCan ID=0x%x",gSendMessage.id);                                                                                         
       snprintf(gStringValue,elcount(gStringValue),"ICan ID=0x%x,ECan ID=0x%x",gDestMessage.id,gDestMessage.id);                           
       snprintf(gStringResult,elcount(gStringResult),"Failed");                                         
       snprintf(gStringStandard,elcount(gStringStandard),"HighBusload%80 ID Keep Conformance");             
       ReportValue(gStringName,gStringValue,gStringResult,gStringStandard);
     }
        if(RouteNum==4&&ICANflagresult==1)
     {  
       snprintf(gStringName,elcount(gStringName),"KCan ID=0x%x",gSendMessage.id);                                      
       snprintf(gStringValue,elcount(gStringValue),"ICan ID=0x%x",gDestMessage.id,gDestMessage.id);                           
       snprintf(gStringResult,elcount(gStringResult),"Passed");                                         
       snprintf(gStringStandard,elcount(gStringStandard),"HighBusload%80 ID Keep Conformance");              
       ReportValue(gStringName,gStringValue,gStringResult,gStringStandard);
     }
    else if(RouteNum==1&&ICANflagresult==0)
     {
       snprintf(gStringName,elcount(gStringName),"KCan ID=0x%x",gSendMessage.id);                                                                                         
       snprintf(gStringValue,elcount(gStringValue),"ICan ID=0x%xx",gDestMessage.id);                           
       snprintf(gStringResult,elcount(gStringResult),"Failed");                                         
       snprintf(gStringStandard,elcount(gStringStandard),"HighBusload%80 ID Keep Conformance");             
       ReportValue(gStringName,gStringValue,gStringResult,gStringStandard);
     }
  }
  cancelTimer(Busload80);
  cancelTimer(Busload4);
  cancelTimer(Busload5);
  cancelTimer(Busload6);
  ACANflagresult=0;ECANflagresult=0;FCANflagresult=0;ICANflagresult=0;
}
testcase CAN_DOS_attacktest_6212_3()
{
  int k=1;
 ReportName("Source Network","Destination Network"); 
 testwaitfortimeout(500);
 snprintf(gTestCaseName,elCount(gTestCaseName),"Access_control_detection_6212_3");
  
   for(RouteNum=1;RouteNum<5;RouteNum++)
  {
    if(RouteNum==1)
    {gSendMessage.id=0x3B5;
     gDestMessage.id=0x3B5;
     cycle=1;
    }
    if(RouteNum==2)
    {gSendMessage.id=0x58C;
     gDestMessage.id=0x58C;
     cycle=1;
    }
    if(RouteNum==3)
    {gSendMessage.id=0x66E;
     gDestMessage.id=0x66E;
     cycle=1;
    }
    if(RouteNum==4)
    {gSendMessage.id=0x671;
     gDestMessage.id=0x671;
     cycle=1;
    }
    gSendMessage.can=1;
    gSendMessage.dlc=8;
    for(i=0;i<8;i++)
    {
      gSendMessage.byte(0)=k++;
    } 
    CANflag = 1;
    setTimer(MsgSendTimer,5); 
    testWaitForTimeout(10000);
    cancelTimer(MsgSendTimer);
    CANflag = 0;
          if(ACANflagresult==1||ECANflagresult==1||FCANflagresult==1||ICANflagresult==1)
     {  
       snprintf(gStringName,elcount(gStringName),"Source Network =kCan");                                      
       snprintf(gStringValue,elcount(gStringValue),"Target Network=ACAN,ECAN,FCAN,ICAN");                           
       snprintf(gStringResult,elcount(gStringResult),"Failed");                                         
       snprintf(gStringStandard,elcount(gStringStandard),"CAN message Do not route!");              
       ReportValue(gStringName,gStringValue,gStringResult,gStringStandard);
     }
    else
     {
       snprintf(gStringName,elcount(gStringName),"Source Network =kCan",gSendMessage.id);                                                                                         
       snprintf(gStringValue,elcount(gStringValue),"Target Network=ACAN,ECAN,FCAN,ICAN",gDestMessage.id,gDestMessage.id);                           
       snprintf(gStringResult,elcount(gStringResult),"Passed");                                         
       snprintf(gStringStandard,elcount(gStringStandard),"CAN message Do not route!");             
       ReportValue(gStringName,gStringValue,gStringResult,gStringStandard);
     }
}
}
testcase Dataframe_health_detection_6213()
{
  int k=1;
 ReportName("Source Network","Destination Network"); 
 testwaitfortimeout(500);
 snprintf(gTestCaseName,elCount(gTestCaseName),"Access_control_detection_6213");
  
   for(RouteNum=1;RouteNum<5;RouteNum++)
  {
    if(RouteNum==1)
    {gSendMessage.id=0x3B5;
     gDestMessage.id=0x3B5;
     cycle=100;
    }
    if(RouteNum==2)
    {gSendMessage.id=0x58C;
     gDestMessage.id=0x58C;
     cycle=1000;
    }
    if(RouteNum==3)
    {gSendMessage.id=0x66E;
     gDestMessage.id=0x66E;
     cycle=2000;
    }
    if(RouteNum==4)
    {gSendMessage.id=0x671;
     gDestMessage.id=0x671;
     cycle=2000;
    }
    gSendMessage.can=1;
    gSendMessage.dlc=4;
    for(i=0;i<4;i++)
    {
      gSendMessage.byte(0)=k++;
    } 
    CANflag = 1;
    setTimer(MsgSendTimer,5); 
    testWaitForTimeout(10000);
    cancelTimer(MsgSendTimer);
    CANflag = 0;
  }
   if(ACANflagresult==1||ECANflagresult==1||FCANflagresult==1||ICANflagresult==1)
     {  
       snprintf(gStringName,elcount(gStringName),"Source Network =kCan");                                      
       snprintf(gStringValue,elcount(gStringValue),"Target Network=ACAN,ECAN,FCAN,ICAN");                           
       snprintf(gStringResult,elcount(gStringResult),"Failed");                                         
       snprintf(gStringStandard,elcount(gStringStandard),"CAN message Do not route!");              
       ReportValue(gStringName,gStringValue,gStringResult,gStringStandard);
     }
    else
     {
       snprintf(gStringName,elcount(gStringName),"Source Network =kCan");                                                                                         
       snprintf(gStringValue,elcount(gStringValue),"Target Network=ACAN,ECAN,FCAN,ICAN");                           
       snprintf(gStringResult,elcount(gStringResult),"Passed");                                         
       snprintf(gStringStandard,elcount(gStringStandard),"CAN message Do not route!");             
       ReportValue(gStringName,gStringValue,gStringResult,gStringStandard);
     }
}
testcase Dataframe_anomaly_detection_6214()
{
  int k=1;
 ReportName("Source Network","Destination Network"); 
 testwaitfortimeout(500);
 snprintf(gTestCaseName,elCount(gTestCaseName),"Access_control_detection_6211_1");
  
   for(RouteNum=1;RouteNum<5;RouteNum++)
  {
    if(RouteNum==1)
    {gSendMessage.id=0x3B5;
     gDestMessage.id=0x3B5;
     cycle=150;
    }
    if(RouteNum==2)
    {gSendMessage.id=0x58C;
     gDestMessage.id=0x58C;
     cycle=1500;
    }
    if(RouteNum==3)
    {gSendMessage.id=0x66E;
     gDestMessage.id=0x66E;
     cycle=1000;
    }
    if(RouteNum==4)
    {gSendMessage.id=0x671;
     gDestMessage.id=0x671;
     cycle=1000;
    }
    gSendMessage.can=1;
    gSendMessage.dlc=8;
    for(i=0;i<8;i++)
    {
      gSendMessage.byte(0)=k++;
    } 
    CANflag = 1;
    setTimer(MsgSendTimer,5); 
    testWaitForTimeout(10000);
    cancelTimer(MsgSendTimer);
    CANflag = 0;
  }
        if(ACANflagresult==1||ECANflagresult==1||FCANflagresult==1||ICANflagresult==1)
     {  
       snprintf(gStringName,elcount(gStringName),"Source Network =kCan");                                      
       snprintf(gStringValue,elcount(gStringValue),"Target Network=ACAN,ECAN,FCAN,ICAN");                           
       snprintf(gStringResult,elcount(gStringResult),"Failed");                                         
       snprintf(gStringStandard,elcount(gStringStandard),"Periodic deviation 50% CAN message Do not route!");              
       ReportValue(gStringName,gStringValue,gStringResult,gStringStandard);
     }
    else
     {
       snprintf(gStringName,elcount(gStringName),"Source Network =kCan");                                                                                         
       snprintf(gStringValue,elcount(gStringValue),"Source Network =kCan");                           
       snprintf(gStringResult,elcount(gStringResult),"Passed");                                         
       snprintf(gStringStandard,elcount(gStringStandard),"Periodic deviation 50% CAN message Do not route!");             
       ReportValue(gStringName,gStringValue,gStringResult,gStringStandard);
     }
}
testcase UDS_session_detection_6215()
{
  int k=1;
 ReportName("Source Network","Destination Network"); 
 testwaitfortimeout(500);
 snprintf(gTestCaseName,elCount(gTestCaseName),"Access_control_detection_6211_1");
 gSendMessage1.can=6; 
 gSendMessage1.dlc=8;
 gSendMessage1.byte(0)=0x02;
 gSendMessage1.byte(1)=0x10;
  gSendMessage1.byte(2)=0x40;
  gSendMessage1.byte(3)=0x55;
  gSendMessage1.byte(4)=0x55;
  gSendMessage1.byte(5)=0x55;
  gSendMessage1.byte(6)=0x55;
  gSendMessage1.byte(7)=0x55;
  CANflag=1;
 output(gSendMessage1);
  testWaitForTimeout(100);
  CANflag=0;
     if(DiagCANflagresult==1&&ErrorDiagCANflagresult==0)
     {  
       snprintf(gStringName,elcount(gStringName),"DiagCan_Rest_ID=0x%x",gSendMessage1.id);                                      
       snprintf(gStringValue,elcount(gStringValue),"DiagCan_Resp_ID=0x%x",gDestMessage1.id);                           
       snprintf(gStringResult,elcount(gStringResult),"Passed");                                         
       snprintf(gStringStandard,elcount(gStringStandard),"DiagCan receive Positive response");              
       ReportValue(gStringName,gStringValue,gStringResult,gStringStandard);
     }
    else if(ErrorDiagCANflagresult==1)
     {
       snprintf(gStringName,elcount(gStringName),"DiagCan_Rest_ID=0x%x",gSendMessage1.id);                                                                                         
       snprintf(gStringValue,elcount(gStringValue),"DiagCan_Rest_ID=0x%x",gDestMessage1.id);                           
       snprintf(gStringResult,elcount(gStringResult),"Failed");                                         
       snprintf(gStringStandard,elcount(gStringStandard),"Other CAN routing DiagRest");             
       ReportValue(gStringName,gStringValue,gStringResult,gStringStandard);
     }
    else if(DiagCANflagresult==0)
    {
       snprintf(gStringName,elcount(gStringName),"KCan ID=0x%x",gSendMessage.id);                                                                                         
       snprintf(gStringValue,elcount(gStringValue),"ACan ID=0x%x,ECan ID=0x%x",gDestMessage.id,gDestMessage.id);                           
       snprintf(gStringResult,elcount(gStringResult),"Failed");                                         
       snprintf(gStringStandard,elcount(gStringStandard),"DiagCan receive Positive response");             
       ReportValue(gStringName,gStringValue,gStringResult,gStringStandard); 
    }
}

testcase Access_control_detection_6211_1()
{
  int k=1;
 ReportName("Source Network","Destination Network"); 
 testwaitfortimeout(500);
 snprintf(gTestCaseName,elCount(gTestCaseName),"Access_control_detection_6211_1");
  
   for(RouteNum=1;RouteNum<5;RouteNum++)
  {
    if(RouteNum==1)
    {gSendMessage.id=0x3B5;
     gDestMessage.id=0x3B5;
     cycle=100;
    }
    if(RouteNum==2)
    {gSendMessage.id=0x58C;
     gDestMessage.id=0x58C;
     cycle=1000;
    }
    if(RouteNum==3)
    {gSendMessage.id=0x66E;
     gDestMessage.id=0x66E;
     cycle=2000;
    }
    if(RouteNum==4)
    {gSendMessage.id=0x671;
     gDestMessage.id=0x671;
     cycle=2000;
    }
    gSendMessage.can=1;
    gSendMessage.dlc=8;
    for(i=0;i<8;i++)
    {
      gSendMessage.byte(0)=k++;
    } 
    CANflag = 1;
    setTimer(MsgSendTimer,5); 
    testWaitForTimeout(1000);
    cancelTimer(MsgSendTimer);
    CANflag = 0;
    if(RouteNum==1&&ACANflagresult==1&&ECANflagresult==1)
     {  
       snprintf(gStringName,elcount(gStringName),"KCan ID=0x%x",gSendMessage.id);                                      
       snprintf(gStringValue,elcount(gStringValue),"ACan ID=0x%x,ECan ID=0x%x",gDestMessage.id,gDestMessage.id);                           
       snprintf(gStringResult,elcount(gStringResult),"Passed");                                         
       snprintf(gStringStandard,elcount(gStringStandard),"ID Keep Conformance");              
       ReportValue(gStringName,gStringValue,gStringResult,gStringStandard);
     }
    else if((RouteNum==1&&ACANflagresult==0)||(RouteNum==1&&ECANflagresult==0))
     {
       snprintf(gStringName,elcount(gStringName),"KCan ID=0x%x",gSendMessage.id);                                                                                         
       snprintf(gStringValue,elcount(gStringValue),"ACan ID=0x%x,ECan ID=0x%x",gDestMessage.id,gDestMessage.id);                           
       snprintf(gStringResult,elcount(gStringResult),"Failed");                                         
       snprintf(gStringStandard,elcount(gStringStandard),"ID Keep Conformance");             
       ReportValue(gStringName,gStringValue,gStringResult,gStringStandard);
     }
        if(RouteNum==2&&ACANflagresult==1)
     {  
       snprintf(gStringName,elcount(gStringName),"KCan ID=0x%x",gSendMessage.id);                                      
       snprintf(gStringValue,elcount(gStringValue),"ACan ID=0x%x",gDestMessage.id);                           
       snprintf(gStringResult,elcount(gStringResult),"Passed");                                         
       snprintf(gStringStandard,elcount(gStringStandard),"ID Keep Conformance");              
       ReportValue(gStringName,gStringValue,gStringResult,gStringStandard);
     }
    else if(RouteNum==2&&ACANflagresult==0)
     {
       snprintf(gStringName,elcount(gStringName),"KCan ID=0x%x",gSendMessage.id);                                                                                         
       snprintf(gStringValue,elcount(gStringValue),"ACan ID=0x%x",gDestMessage.id);                           
       snprintf(gStringResult,elcount(gStringResult),"Failed");                                         
       snprintf(gStringStandard,elcount(gStringStandard),"ID Keep Conformance");             
       ReportValue(gStringName,gStringValue,gStringResult,gStringStandard);
     }
        if(RouteNum==3&&ICANflagresult==1&&ECANflagresult==1)
     {  
       snprintf(gStringName,elcount(gStringName),"KCan ID=0x%x",gSendMessage.id);                                      
       snprintf(gStringValue,elcount(gStringValue),"ICan ID=0x%x,ECan ID=0x%x",gDestMessage.id,gDestMessage.id);                           
       snprintf(gStringResult,elcount(gStringResult),"Passed");                                         
       snprintf(gStringStandard,elcount(gStringStandard),"ID Keep Conformance");              
       ReportValue(gStringName,gStringValue,gStringResult,gStringStandard);
     }
    else if((RouteNum==3&&ECANflagresult==0)||(RouteNum==1&&ICANflagresult==0))
     {
       snprintf(gStringName,elcount(gStringName),"KCan ID=0x%x",gSendMessage.id);                                                                                         
       snprintf(gStringValue,elcount(gStringValue),"ICan ID=0x%x,ECan ID=0x%x",gDestMessage.id,gDestMessage.id);                           
       snprintf(gStringResult,elcount(gStringResult),"Failed");                                         
       snprintf(gStringStandard,elcount(gStringStandard),"ID Keep Conformance");             
       ReportValue(gStringName,gStringValue,gStringResult,gStringStandard);
     }
        if(RouteNum==4&&ICANflagresult==1)
     {  
       snprintf(gStringName,elcount(gStringName),"KCan ID=0x%x",gSendMessage.id);                                      
       snprintf(gStringValue,elcount(gStringValue),"ICan ID=0x%x",gDestMessage.id,gDestMessage.id);                           
       snprintf(gStringResult,elcount(gStringResult),"Passed");                                         
       snprintf(gStringStandard,elcount(gStringStandard),"ID Keep Conformance");              
       ReportValue(gStringName,gStringValue,gStringResult,gStringStandard);
     }
    else if(RouteNum==1&&ICANflagresult==0)
     {
       snprintf(gStringName,elcount(gStringName),"KCan ID=0x%x",gSendMessage.id);                                                                                         
       snprintf(gStringValue,elcount(gStringValue),"ICan ID=0x%xx",gDestMessage.id);                           
       snprintf(gStringResult,elcount(gStringResult),"Failed");                                         
       snprintf(gStringStandard,elcount(gStringStandard),"ID Keep Conformance");             
       ReportValue(gStringName,gStringValue,gStringResult,gStringStandard);
     }
  }
  ACANflagresult=0;ECANflagresult=0;FCANflagresult=0;ICANflagresult=0;
}
void ReportValue(char sTestVaribleName[],char sTestValue[],char sResult[],char sStandard[])
{
    char lTestResultDesc[1000];
  
    snprintf(lTestResultDesc,elcount(lTestResultDesc),
    "{\"values\":[\"%s\",\"%s\",\"%s\",\"%s\"]}",
    sTestVaribleName,sTestValue,sResult,sStandard);
     
    if(strncmp(sResult,"Passed",6) == 0)
    {
        TestStepPass("1",lTestResultDesc);     
    }
    else if(strncmp(sResult,"Failed",6) == 0)
    {
        TestStepFail("1",lTestResultDesc);
    }
    
}
void ReportName(char sTestCase[],char sTestValueName[])
{
    char lTestResultDesc[1000];
  
    snprintf(lTestResultDesc,elcount(lTestResultDesc),
    "{\"titles\": [\"%s[4]\",\"%s[4]\",\"Result[1]\",\"Standard[2]\"]}",
    sTestCase,sTestValueName);
    TestStep ("1",lTestResultDesc);
}